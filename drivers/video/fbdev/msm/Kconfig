## drivers/video/fbdev/msm/Kconfig
```kconfig
config FB_MSM_MDSS_KCAL_CTRL depends on FB_MSM_MDSS
      bool "MDSS color control" 
      default n
      ---help---
        Enable sysfs for rgb/lut control for mdss-mdp display controllers
        in the MDSS sub-system.
```
